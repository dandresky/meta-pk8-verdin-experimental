## conf/layer.conf
```bitbake
# We have a conf and classes directory, add to BBPATH
BBPATH .= ":${LAYERDIR}"

# We have recipes-* directories, add to BBFILES
BBFILES += "${LAYERDIR}/recipes-*/*/*.bb \
            ${LAYERDIR}/recipes-*/*/*.bbappend"

BBFILE_COLLECTIONS += "meta-pk8-verdin-experimental"
BBFILE_PATTERN_meta-pk8-verdin-experimental = "^${LAYERDIR}/"
BBFILE_PRIORITY_meta-pk8-verdin-experimental = "6"

LAYERDEPENDS_meta-pk8-verdin-experimental = "core"
LAYERSERIES_COMPAT_meta-pk8-verdin-experimental = "dunfell"
```
